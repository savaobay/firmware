## general/package/libfreetype-openipc/Config.in
```kconfig
config BR2_PACKAGE_LIBFREETYPE_OPENIPC
	bool "libfreetype-openipc"
	help
	  Sample for Libfreetype.
```

## general/package/libharfbuzz-openipc/Config.in
```kconfig
config BR2_PACKAGE_LIBHARFBUZZ_OPENIPC
	bool "libharfbuzz-openipc"
	depends on BR2_PACKAGE_FFMPEG_OPENIPC
```

## general/package/libmp4v2-openipc/Config.in
```kconfig
config BR2_PACKAGE_LIBMP4V2_OPENIPC
	bool "libmp4v2-openipc"
    depends on BR2_PACKAGE_ZLIB
```

## general/package/serial/Config.in
```kconfig
config BR2_PACKAGE_SERIAL
	bool "serial"
	select BR2_PACKAGE_LIBCURL_OPENIPC
	select BR2_PACKAGE_MBEDTLS_OPENIPC

	help
	  read/write serial.
```
